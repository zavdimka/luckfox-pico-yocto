## conf/bblayers.conf
```bitbake
# POKY_BBLAYERS_CONF_VERSION is increased each time build/conf/bblayers.conf
# changes incompatibly
POKY_BBLAYERS_CONF_VERSION = "2"

BBPATH = "${TOPDIR}"
BBFILES ?= ""

BBLAYERS ?= " \
  /home/dimka/luckfox-pico/yocto-walnascar/poky/meta \
  /home/dimka/luckfox-pico/yocto-walnascar/poky/meta-poky \
  /home/dimka/luckfox-pico/yocto-walnascar/poky/meta-yocto-bsp \
  "
```

## conf/distro/luckfox.conf
```bitbake
# Luckfox Pico Linux Distribution Configuration
# Based on Poky reference distribution

require conf/distro/poky.conf

DISTRO = "luckfox"
DISTRO_NAME = "Luckfox Pico Linux"
DISTRO_VERSION = "1.0"
DISTRO_CODENAME = "pico"

MAINTAINER = "Dmitry Zavgorodniy <zavdimka@gmail.com>"

# SDK version info
SDK_VENDOR = "-luckfoxsdk"
SDK_VERSION = "${@d.getVar('DISTRO_VERSION').replace('snapshot-${METADATA_REVISION}', 'snapshot')}"
SDK_VERSION[vardepvalue] = "${SDK_VERSION}"

SDK_NAME = "${DISTRO}-${TCLIBC}-${SDKMACHINE}-${IMAGE_BASENAME}-${TUNE_PKGARCH}-${MACHINE}"
SDKPATHINSTALL = "/opt/${DISTRO}/${SDK_VERSION}"

# Target OS info
TARGET_VENDOR = "-luckfox"

# Remove Poky warning from login banner
POKY_DEFAULT_DISTRO_FEATURES:remove = "ptest"

# Distro features - optimized for embedded RV1106
DISTRO_FEATURES:append = " usrmerge"
DISTRO_FEATURES:remove = "x11 wayland vulkan opengl systemd"
DISTRO_FEATURES_BACKFILL_CONSIDERED:append = " systemd"

# Use sysvinit as init system
VIRTUAL-RUNTIME_init_manager = "sysvinit"
VIRTUAL-RUNTIME_initscripts = "initscripts"
VIRTUAL-RUNTIME_login_manager = "busybox"
VIRTUAL-RUNTIME_dev_manager = "busybox-mdev"

# Kernel and bootloader preferences
PREFERRED_PROVIDER_virtual/kernel = "linux-luckfox"
PREFERRED_PROVIDER_virtual/bootloader = "u-boot-luckfox"

# Package management
PACKAGE_CLASSES ?= "package_ipk"

# Extra image features
EXTRA_IMAGE_FEATURES ?= "debug-tweaks ssh-server-dropbear package-management"

# Toolchain settings
# Note: Using glibc for Yocto build system
# The external uClibc toolchain is used via luckfox-ext-toolchain.bbclass
TCLIBC = "glibc"

# Version control
DISTRO_VERSION[vardepsexclude] = "DATE"
SDK_VERSION[vardepsexclude] = "DATE"
```

## conf/layer.conf
```bitbake
# Layer configuration for Luckfox Pico RV1106
BBPATH .= ":${LAYERDIR}"
BBFILES += "${LAYERDIR}/recipes-*/*/*.bb ${LAYERDIR}/recipes-*/*/*.bbappend"

BBFILE_COLLECTIONS += "luckfoxpico"
BBFILE_PATTERN_luckfoxpico = "^${LAYERDIR}/"
BBFILE_PRIORITY_luckfoxpico = "7"
LAYERVERSION_luckfoxpico = "1"
LAYERDEPENDS_luckfoxpico = "core"
LAYERSERIES_COMPAT_luckfoxpico = "walnascar"
```

## conf/machine/luckfox-pico-sd.conf
```bitbake
# Luckfox Pico RV1106 - SD Card Configuration
# Inherits from base luckfox-pico machine, changes boot medium to SD card

require conf/machine/luckfox-pico.conf

# Override boot medium for SD card
RK_BOOT_MEDIUM = "sd_card"
ROCKCHIP_BOOT_MEDIUM = "${RK_BOOT_MEDIUM}"

# SD card specific device tree
KERNEL_DTS_FILE = "rv1106g-luckfox-pico-max-t1.dts"

# Partition layout (same as eMMC, but will generate mmcblk1 device paths)
# Format: size@offset(name) - offset is optional, calculated automatically
ROCKCHIP_PARTITION_LAYOUT = "32K(env),256K@32K(idblock),256K(uboot),32M(boot),-(rootfs)"
#partition numbers starts from 1 for mmcblk1p1, mmcblk1p2, ...
# so rootfs will be mmcblk1p5
RK_BOOT_ROOT_ARGS = "root=/dev/mmcblk1p5 rootfstype=ext4"
MACHINE_FEATURES += "ext4 usbhost"
```

## conf/machine/luckfox-pico-spi-nand.conf
```bitbake
# Luckfox Pico RV1106 - SPI NAND Configuration
# Inherits from base luckfox-pico machine, changes boot medium to SPI NAND

require conf/machine/luckfox-pico.conf

# Override boot medium for SPI NAND
RK_BOOT_MEDIUM = "spi_nand"
ROCKCHIP_BOOT_MEDIUM = "${RK_BOOT_MEDIUM}"

RK_ENABLE_AB_UPDATE = "0"

# U-Boot SFC (SPI Flash Controller) config fragment for SPI NAND/NOR
RK_UBOOT_DEFCONFIG_FRAGMENT = "rk-sfc.config"

# SPI NAND specific device tree
KERNEL_DTS_FILE = "rv1106g-luckfox-pico-max-t1.dts"

# Partition layout for SPI NAND (UBI volumes)
# Format: size@offset(name:fstype) - offset and fstype are optional, calculated automatically
RK_PARTITION_LAYOUT = "32K(env),256K@256K(idblock),512K(uboot),32M(boot),180M(rootfs:ubifs)"

# SPI NAND Flash parameters (used for UBI/UBIFS calculation)
# Block size: 128K, Page size: 2K
RK_NAND_BLOCK_SIZE = "131072"
RK_NAND_PAGE_SIZE = "2048"

# Boot arguments for UBI/UBIFS
# partition numbers starts from 0
# ubi.mtd=4: attach UBI to MTD partition 4 (rootfs is the 5th partition, index 4)
# root=ubi0:rootfs: mount the "rootfs" UBI volume from ubi0
# rootfstype=ubifs: use UBIFS filesystem for SPI NAND
# rw: mount root filesystem read-write
RK_BOOT_ROOT_ARGS = "ubi.mtd=4 root=ubi0:rootfs rootfstype=ubifs ubi.fm_autoconvert=1"
MACHINE_FEATURES += "ubifs usbhost"
```

## conf/machine/luckfox-pico.conf
```bitbake
# Luckfox Pico RV1106 machine definition
require conf/machine/include/arm/armv7a/tune-cortexa7.inc

SOC_FAMILY = "rockchip"
MACHINEOVERRIDES =. "rockchip:rv1106:"

SERIAL_CONSOLE = "ttyFIQ0,115200n8"
KERNEL_IMAGETYPE = "Image"

# Device tree source file (machine-specific)
KERNEL_DTS_FILE = "rv1106g-av.dts"

UBOOT_MACHINE = "luckfox_rv1106_uboot_defconfig"
UBOOT_SUFFIX = "img"
UBOOT_ENTRYPOINT = "0x00200000"

# SDK-style boot medium configuration (matches SDK BoardConfig files)
# Options: sd_card, emmc, spi_nand, spi_nor
RK_BOOT_MEDIUM = "emmc"

# A/B Update Configuration
# Enable dual boot A/B partitions for OTA updates with automatic rollback
RK_ENABLE_AB_UPDATE ?= "1"

# Partition layout (SDK-compatible format)
# Format: size@offset(name) where offset is optional (auto-calculated if omitted)
# Size units: K (KB), M (MB), G (GB), - (fill remaining space)
# Example from SDK: "32K(env),256K@32K(idblock),256K(uboot),32M(boot),-(rootfs)"
# Default: Single boot partition layout with userdata
# RK_PARTITION_LAYOUT = "32K(env),256K@32K(idblock),256K(uboot),16M(boot),256M(rootfs),-(userdata:ext4)"
# A/B layout: boot_a/boot_b (16MB each), rootfs_a/rootfs_b (256MB each), userdata (remaining)
RK_PARTITION_LAYOUT = "32K(env),256K@32K(idblock),256K(uboot),16M(boot_a),16M(boot_b),256M(rootfs_a),256M(rootfs_b),-(userdata:ext4)"
#partition numbers starts from 1 for mmcblk0p1, mmcblk0p2, ...
# Single boot: rootfs = mmcblk0p5, userdata = mmcblk0p6
# Note: root= will be set dynamically by U-Boot based on active_slot
# RK_BOOT_ROOT_ARGS = "root=/dev/mmcblk0p5 rootfstype=ext4"
#for A/B update use the following instead
RK_BOOT_ROOT_ARGS = "root=/dev/mmcblk0p6 rootfstype=ext4"

# Fastboot mode (uses _TB variants of INI files)
RK_ENABLE_FASTBOOT ?= "n"

# U-Boot defconfig settings (matching SDK build.sh logic)
RK_UBOOT_DEFCONFIG = "luckfox_rv1106_uboot_defconfig"

PREFERRED_PROVIDER_virtual/kernel = "linux-luckfox"
PREFERRED_PROVIDER_virtual/bootloader = "u-boot-luckfox"

# Kernel version is 5.10.160 - set OLDEST_KERNEL to match
OLDEST_KERNEL = "5.10"

MACHINE_FEATURES += "wifi usbgadget ext4"

# Keep rootfs/ext4 layout aligned with the legacy SDK
EXTRA_IMAGEDEPENDS += "u-boot-luckfox"
```
